## sdkconfig.defaults
```kconfig
# Reduce Flash Usage
CONFIG_BT_ENABLED=n
CONFIG_BT_BLE_ENABLED=n
CONFIG_BT_CLASSIC_ENABLED=n

# Compiler Optimization for Size
CONFIG_COMPILER_OPTIMIZATION_SIZE=y
CONFIG_COMPILER_OPTIMIZATION_DEFAULT=n
CONFIG_COMPILER_OPTIMIZATION_PERF=n

# Log Level - Info is enough
CONFIG_LOG_DEFAULT_LEVEL=3
CONFIG_LOG_DEFAULT_LEVEL_INFO=y
CONFIG_LOG_DEFAULT_LEVEL_VERBOSE=n
CONFIG_LOG_DEFAULT_LEVEL_DEBUG=n

# Partition Table
CONFIG_PARTITION_TABLE_CUSTOM=y
CONFIG_PARTITION_TABLE_CUSTOM_FILENAME="partitions.csv"
CONFIG_PARTITION_TABLE_OFFSET=0x8000
```
